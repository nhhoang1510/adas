## build/conf/local.conf
```bitbake
MACHINE   = "raspberrypi4-64"
DISTRO    = "poky"
DEFAULTTUNE = "cortexa72"

INIT_MANAGER = "systemd"

PACKAGE_CLASSES = "package_ipk"

DL_DIR     ?= "${TOPDIR}/../downloads"
SSTATE_DIR ?= "${TOPDIR}/../sstate-cache"
BB_NUMBER_THREADS ?= "4"
PARALLEL_MAKE     ?= "-j 4"
TMPDIR = "${TOPDIR}/tmp"

INHERIT += "rm_work"
RM_WORK_EXCLUDE += "adas-app"

DISTRO_FEATURES:append  = " wifi bluetooth"
DISTRO_FEATURES:remove  = "x11 wayland vulkan"
LICENSE_FLAGS_ACCEPTED  += "synaptics-killswitch commercial"

VC4GRAPHICS:pn-rpi-config = "0"

GPU_MEM              = "64"
DISABLE_RPI_BOOT_LOGO = "1"
DISABLE_SPLASH       = "1"
SPLASH               = ""
IMAGE_FEATURES:remove = "splash"
BOOT_DELAY           = "0"
BOOT_DELAY_MS        = "0"
ENABLE_SPI_BUS       = "1"
ENABLE_I2C           = "1"
ENABLE_UART          = "1"

RPI_KERNEL_DEVICETREE_OVERLAYS:append = " overlays/piscreen.dtbo overlays/piscreen2r.dtbo"

RPI_EXTRA_CONFIG = "dtoverlay=piscreen,speed=32000000,rotate=90,fps=20\ndtparam=audio=off\ninitial_turbo=30"

CMDLINE_DEBUG = "audit=0 quiet loglevel=3"

SYSTEMD_AUTO_ENABLE:pn-hostapd = "enable"

IMAGE_FSTYPES       = "wic.bz2 wic.bmap"
EXTRA_IMAGE_FEATURES = "debug-tweaks ssh-server-openssh"

hostname:pn-base-files = "adas-pi4"

DEFAULT_TIMEZONE = "Asia/Ho_Chi_Minh"

IMAGE_ROOTFS_SIZE        ?= "3145728"
IMAGE_ROOTFS_EXTRA_SPACE  = "524288"

PACKAGECONFIG:append:pn-opencv = " gstreamer v4l python3 jpeg png eigen"

PACKAGECONFIG:append:pn-qtbase = " linuxfb fontconfig"

PACKAGECONFIG:append:pn-gstreamer1.0-plugins-good = " v4l2 jpeg"
PACKAGECONFIG:remove:pn-gstreamer1.0-plugins-bad = "vulkan"

TOOLCHAIN_HOST_TASK:append   = " nativesdk-cmake nativesdk-packagegroup-qt5-toolchain-host"
TOOLCHAIN_TARGET_TASK:append = " \
    qtbase-dev qtdeclarative-dev \
    onnxruntime-dev opencv-dev \
    gstreamer1.0-dev gstreamer1.0-plugins-base-dev \
"

CONF_VERSION = "2"
```

## sources/meta-adas/conf/layer.conf
```bitbake
BBPATH .= ":${LAYERDIR}"
BBFILES += "${LAYERDIR}/recipes-*/*/*.bb \
            ${LAYERDIR}/recipes-*/*/*.bbappend"

BBFILE_COLLECTIONS += "meta-adas"
BBFILE_PATTERN_meta-adas = "^${LAYERDIR}/"
BBFILE_PRIORITY_meta-adas = "10"

LAYERSERIES_COMPAT_meta-adas = "scarthgap"

LAYERDEPENDS_meta-adas = " \
    core \
    raspberrypi \
    openembedded-layer \
    meta-python \
    qt5-layer \
"
```
